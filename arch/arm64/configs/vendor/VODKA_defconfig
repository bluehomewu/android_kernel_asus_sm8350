## arch/arm64/configs/vendor/VODKA_defconfig
```kconfig
###############################################################################################
#
# Reverse the order of the configs for the override to work properly
# Correct order is : 
#1.base_defconfig : kernel/msm-5.4/arch/arm64/configs/gki_defconfig 
#2.GKI.config : /kernel/msm-5.4/arch/arm64/configs/vendor/lahaina_GKI.config (GKI.config)
#3.QGKI.config : /kernel/msm-5.4/arch/arm64/configs/vendor/lahaina_QGKI.config  (QGKI.config)
#4.Consolidate.config : /kernel/msm-5.4/arch/arm64/configs/vendor/lahaina_consolidate.config
#5.debug.config : kernel/msm-5.4/arch/arm64/configs/vendor/lahaina_debug.config  (debug.config)
#6.asus_defconfig : kernel/msm-5.4/arch/arm64/configs/vendor/VODKA_defconfig
#
###############################################################################################
CONFIG_LOCALVERSION="-qgki-debug"
CONFIG_MACH_ASUS_VODKA=y
CONFIG_TOUCHSCREEN_FTS_ZF=m
# CONFIG_TOUCHSCREEN_ST is not set
# CONFIG_TOUCHSCREEN_FTS is not set
CONFIG_NETFILTER_XT_TARGET_LOG=y
CONFIG_NETFILTER_XT_MATCH_MULTIPORT=y
GOODIX_FINGERPRINT_2ND=m
CONFIG_LATCH_AK09973=m
CONFIG_LATCH_SENSOR=m
CONFIG_HALL_SENSOR=m
CONFIG_INPUT_SX932X_VODKA=m
```

## drivers/aura_sync/Kconfig
```kconfig
# SPDX-License-Identifier: GPL-2.0-only
config AURALIGHT_MS51_PHONE
	tristate "ASUS Picasso Nuvoton MS51 phone AuraLight"
	depends on MACH_ASUS_PICASSO && I2C && GPIOLIB && OF
	depends on LEDS_CLASS && REGULATOR
	help
	  Enable the onboard MS51 AuraLight controller on ASUS Picasso.
	  If built as a module, it will be called ms51_phone.
```

## drivers/platform/asus/Kconfig
```kconfig
# SPDX-License-Identifier: GPL-2.0-only
# Asus configuration options

config MACH_ASUS
	bool "Asus device"
	help
	  Support for Asus products

config ASUS_HWID
	tristate "ASUS hardware id driver"
	depends on MACH_ASUS_PICASSO
	help
	  Support the Picasso hardware identifier interface.

menu "Asus board selection"

config MACH_ASUS_SAKE
	bool "SAKE board"
	select MACH_ASUS
	help
	  Support for Sake

config MACH_ASUS_VODKA
	bool "VODKA board"
	select MACH_ASUS
	help
	  Support for Vodka
config ASUS_PICASSO_QTI_EMBEDDED
	bool "PICASSO bool config"
	help
	  Support for Picasso on GKI driver

config ASUS_PICASSO_GKI
	bool "PICASSO bool config"
	help
	  Picasso module for GKI

config MACH_ASUS_PICASSO
	bool "PICASSO board"
	depends on ARCH_LAHAINA
	select MACH_ASUS
	select ASUS_PICASSO_QTI_EMBEDDED
	help
	  Support for Picasso

endmenu
```

## drivers/sensors/Kconfig
```kconfig
config ASUS_ASH
	bool "ASUS Picasso ambient light and proximity sensors"
	depends on MACH_ASUS_PICASSO && I2C && INPUT && GPIOLIB && REGULATOR
	default y
	help
	  Build the single VCNL36866 sensor pipeline used by Picasso.
	  This also supplies proximityStatus() to the ROG touchscreen.

config SENSORS_ICM206XX
	tristate "ICM206XX 6-axis gyroscope and acceleromater combo"
	depends on INPUT && SPI
	help
	  Say Y here if you want to support InvenSense ICM206XX
	  connected via an I2C bus.

	  To compile this driver as a module, choose M here: the
	  module will be called ICM206XX.

config ASUS_PICASSO_ICM206XX
	bool "ASUS Picasso secondary accelerometer and gyroscope"
	depends on MACH_ASUS_PICASSO && INPUT && SPI && I2C
	depends on GPIOLIB && REGULATOR && PM && PROC_FS
	default y
	help
	  Build the ICM20690 secondary IMU interfaces used by the sensor HAL.
	  This driver registers both SPI and I2C drivers and must be built in.
```

## net/sla/Kconfig
```kconfig
# SPDX-License-Identifier: GPL-2.0-only
config SLA_STAIC_COLLECT
	bool "ASUS Picasso SLA statistics collection"
	depends on MACH_ASUS_PICASSO && NET && INET && NETFILTER && PROC_FS
	help
	  Enable the ASUS vendor SLA statistics interface and netfilter hooks.

config SLA
	tristate "ASUS Picasso SLA module"
	depends on SLA_STAIC_COLLECT
	help
	  Build the vendor SLA statistics collector. Its module name is sla.
```
